; S3C2410 Watch-Dog Disable.
d.s 0x53000000 %l 00000000
; S3C2410 PLL & Clock Initialize.
;d.s 0x4C000004 %l 0x0008E031
;d.s 0x4C000008 %l 0x00028041
;d.s 0x4C000014 %l 0x00000003
; S3C2410 GPIO Initialize.
;d.s 0x56000070 %l 0x00100000
; S3C2410 Memory Control Block Initialize.
d.s 0x48000000 %l 0x22121112
d.s 0x48000004 %l 0x00000700
d.s 0x48000008 %l 0x00000700
d.s 0x4800000C %l 0x00000700
d.s 0x48000010 %l 0x00000700
d.s 0x48000014 %l 0x00000700
d.s 0x48000018 %l 0x00000700
d.s 0x4800001C %l 0x00018006
d.s 0x48000020 %l 0x00018006
d.s 0x48000024 %l 0x008e067b
d.s 0x48000028 %l 0x00000032
d.s 0x4800002C %l 0x00000020
d.s 0x48000030 %l 0x00000020

