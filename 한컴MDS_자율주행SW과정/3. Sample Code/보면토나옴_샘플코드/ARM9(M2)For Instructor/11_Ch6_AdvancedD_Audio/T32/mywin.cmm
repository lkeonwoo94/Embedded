// T32 Mon Mar 12 10:40:43 2007

 B::
 
 TOOLBAR ON
 STATUSBAR ON
 WINPAGE.RESET
 
 WINCLEAR
 WINPOS 83.571 0.0 58. 15. 0. 1. W005
 WINTABS 26. 26.
 sYmbol.Browse
 
 WINPOS 0.0 0.0 79. 29. 13. 1. W002
 WINTABS 10. 10. 25. 62.
 Data.List
 
 WINPOS 83.571 34.385 58. 7. 0. 0. W003
 Var.Ref
 
 WINPOS 83.714 20.692 58. 8. 13. 1. W006
 Data.dump (0x30000000) /DIALOG
 
 WINPOS 0.0 34.385 79. 5. 0. 0. W004
 Var.Watch
 
 
 WINPOS 84.286 3.0769 80. 25. 0. 0. W005
 ;per "C:\T32\S3C2440A.per" /sl
 
 WINPAGE.SELECT P000     
 
 ENDDO
