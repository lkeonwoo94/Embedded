// T32 Wed May 18 19:00:10 2005

 B::
 
 TOOLBAR ON
 STATUSBAR ON
 WINPAGE.RESET
 
 WINCLEAR
 WINPOS 83.571 0.0 58. 15. 0. 1. W005
 WINTABS 26. 26.
 sYmbol.Browse
 
 WINPOS 0.0 0.0 79. 29. 13. 1. W002
 WINTABS 10. 10. 25. 62.
 Data.List
 
 WINPOS 83.571 34.385 58. 7. 0. 0. W003
 Var.Ref
 
 WINPOS 83.714 20.692 58. 8. 13. 1. W006
 Data.dump (0x30000000) /DIALOG
 
 WINPOS 0.0 34.385 79. 5. 0. 0. W004
 Var.Watch
 
 
 WINPAGE.SELECT P000     
 
 ENDDO
