;Default startup program for TRACE32
;
;This startup program can be modified according to your needs.

;choose hex mode for input
 radix hex

;Add some extra buttons to the toolbar

 menu.rp
 (
  add
  toolbar
  (
   separator
 toolitem "download elf file and go"   "RU,Y"           "do .\t32\loadGo.cmm"
 toolitem "download elf file and jump Main"          "LD,B"           "do .\t32\myload.cmm"
 toolitem "flash erase 64K and write ALL"              "F6,R"             "do .\t32\flash_rebis_atmel_0x10000.cmm"
 toolitem "flash erase ALL and write ALL"              "FA,W"             "do .\t32\flash_rebis_atmel_all.cmm"
 toolitem "teminal COM1, 119200"     "TE,G"           "do .\t32\terminal.cmm"
 toolitem "close windows"              "WC,V"             "winclear"
    separator
   toolitem "Source/List" "list" "Data.List"
   toolitem "Memory Dump" "dump" "Data.dump"
   toolitem "Register" "reg" "Register"
   separator
   toolitem "Watch" ":varwatch" "Var.Watch"
   toolitem "Stack" ":varframe" "Var.Frame /l /c"
   toolitem "Automatic Watch" ":varref" "Var.Ref"
   separator
   toolitem "List Breakpoints" "break" "Break.List"
   toolitem "List Symbols" "symbols" "sYmbol.Browse"
   separator
  )
 )

 if language()!=""
 (
  local &menuname
  &menuname="~~/t32"+language()
  menu.rp &menuname
 )

;Recall and Define History File
 autostore , history bookmark

 enddo
